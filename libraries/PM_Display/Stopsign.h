#include "GD.h"

#ifndef _Stopsign_h_
#define _Stopsign_h_

class Stopsign
{
  // Define the stopsign as a 4x3 character block - the actual image is 24x24 pixels, but it
  // needs to be an even number of characters wide in order to be centered correctly.
  // NOTE:  the char IDs used for the stopsign must not conflict with other character IDs,
  //        so we place them just before the IDs used for dots (see display.h), i.e., < 253
  #define CHAR_ID_STOPSIGN (253 - 12)
  
  bool initialized;
  
  void loadCharColor(uint8_t chrId, uint8_t colorId, uint16_t colorValue)
  {
    GD.wr16(RAM_PAL + (8*chrId) + (2*colorId), colorValue);
  }

  void loadChars()
  {
    // Each pixel is defined by 2 bits (4 color choicess).  The order
    // below is how they appear on the screen.
    static PROGMEM prog_uchar stopsign_pic[] =
    {
      0x00, 0x00,  0x03, 0xff,  0xff, 0xc0,  0x00, 0x00,
      0x00, 0x00,  0x0f, 0xff,  0xff, 0xf0,  0x00, 0x00,
      0x00, 0x00,  0x3f, 0xff,  0xff, 0xfc,  0x00, 0x00,
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      0x00, 0x00,  0x03, 0xff,  0xff, 0xc0,  0x00, 0x00
    };

    // Centered left-to-right (screen is 50 chars wide), and centered
    // between the logo and the digits vertically (see display.h).
    static int x = 23;
    static int y = 10;

    // For each character, extract the data from the picture defined above
    // (which is 4 characters wide and 3 characters tall), write the pixel
    // data to the GD, load both used colors (0 and 3) as transparent, and
    // write the character to is position on the display.
    for (int c = 0; c < 12; c++)
    {
      int id = c + CHAR_ID_STOPSIGN;
      for (int i = 0; i < 8; i++)
      {
        int row = 8 * (c / 4) + i;
        int col = 2 * (c % 4);
        GD.copy(RAM_CHR + 16*id + 2*i, &stopsign_pic[8*row + col], 2);
      }
      loadCharColor(id, 0, TRANSPARENT);
      loadCharColor(id, 3, TRANSPARENT);
      
      GD.wr(RAM_PIC + (x + (c % 4)) + 64*(y + (c / 4)), id);
    }
  }
  
public:  
  Stopsign()
  {
    initialized = false;
  }
  
  void draw(bool inColor)
  {
    // NOTE:  we can't initialize in the constructor because the GD has not
    // necessarily been initialized yet.
    if (!initialized)
    {
      loadChars();
      initialized = true;
    }
    
    GD.waitvblank();
    
    uint16_t color = inColor ? RGB(0xff, 0, 0) : TRANSPARENT;

    for (int c = 0; c < 12; c++)
    {
      int id = CHAR_ID_STOPSIGN + c;
      loadCharColor(id, 3, color);
    }
  }
};

#endif

